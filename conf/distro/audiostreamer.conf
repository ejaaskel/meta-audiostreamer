## conf/distro/audiostreamer.conf
```bitbake
include poky.conf

DISTRO = "audiostreamer"

IMAGE_INSTALL:append = "avahi-daemon wpa-supplicant gstreamer1.0 iw openssh sample-files"

KERNEL_MODULE_AUTOLOAD:append = " snd-aloop"

DISTROOVERRIDES:append = "${@':controller-build' if d.getVar('AUDIOSTREAMER_BUILD_TYPE') == 'controller' else ''}"
DISTROOVERRIDES:append = "${@':speaker-build' if d.getVar('AUDIOSTREAMER_BUILD_TYPE') == 'speaker' else ''}"

# dnsmasq is only used in speaker build for assigning ip addresses to devices connecting through hostapd
BBMASK:append:controller-build = " meta-audiostreamer/recipes-support/dnsmasq/dnsmasq_2.89.bbappend"

# DISABLE_VC4GRAPHICS = "1"
```

## conf/layer.conf
```bitbake
# We have a conf and classes directory, add to BBPATH
BBPATH .= ":${LAYERDIR}"

# We have recipes-* directories, add to BBFILES
BBFILES += "${LAYERDIR}/recipes-*/*/*.bb \
            ${LAYERDIR}/recipes-*/*/*.bbappend"

BBFILE_COLLECTIONS += "meta-audiostreamer"
BBFILE_PATTERN_meta-audiostreamer = "^${LAYERDIR}/"
BBFILE_PRIORITY_meta-audiostreamer = "6"

LAYERDEPENDS_meta-audiostreamer = "core"
LAYERSERIES_COMPAT_meta-audiostreamer = "mickledore"

BBFILES_DYNAMIC += " \
    raspberrypi:${LAYERDIR}/dynamic-layers/meta-raspberrypi/*/*/*.bb \
    raspberrypi:${LAYERDIR}/dynamic-layers/meta-raspberrypi/*/*/*.bbappend \
"
```
